## rpi_security_system/Config.in
```kconfig
config BR2_PACKAGE_RPI_SECURITY_SYSTEM
	bool "rpi_security_system"
	depends on BR2_PACKAGE_C_PERIPHERY
	help
	  An application for protection from thieves
```
